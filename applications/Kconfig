## applications/appinit/Kconfig
```kconfig
config APPLICATION_APPINIT
	tristate "App Init"
	default n
	---help---
		Enable the App Init application

if APPLICATION_APPINIT

config APPLICATION_APPINIT_PROGNAME
	string "Program name"
	default "appinit"
	---help---
		This is the name of the program that will be used when the NSH ELF
		program is installed.

config APPLICATION_APPINIT_PRIORITY
	int "App Init task priority"
	default 100

config APPLICATION_APPINIT_STACKSIZE
	int "App Init stack size"
	default 2048

endif
```

## applications/appstart/Kconfig
```kconfig
config APPLICATION_APPSTART
	tristate "App start"
	default n
	---help---
		Enable the App start application

if APPLICATION_APPSTART

config APPLICATION_APPSTART_PROGNAME
	string "Program name"
	default "appstart"
	---help---
		This is the name of the program that will be used when the NSH ELF
		program is installed.

config APPLICATION_APPSTART_PRIORITY
	int "App start task priority"
	default 100

config APPLICATION_APPSTART_STACKSIZE
	int "App start stack size"
	default 2048

endif
```

## applications/ledcontrol/Kconfig
```kconfig
config EXAMPLES_LEDCONTROL
	tristate "Led Controller"
	default n
	---help---
		Enable the Led Controller application

if EXAMPLES_LEDCONTROL

config EXAMPLES_LEDCONTROL_PROGNAME
	string "Program name"
	default "ledcontrol"
	---help---
		This is the name of the program that will be used when the NSH ELF
		program is installed.

config EXAMPLES_LEDCONTROL_PRIORITY
	int "led controller task priority"
	default 100

config EXAMPLES_LEDCONTROL_STACKSIZE
	int "Led Controller stack size"
	default 4096

endif
```
